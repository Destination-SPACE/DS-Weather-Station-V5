## firmware/apps/01-Blink/sample.yaml
```yaml
sample:
  name: Blink Sample
tests:
  blink:
    tags:
      - LED
      - gpio
    filter: dt_enabled_alias_with_parent_compat("led0", "gpio-leds")
    depends_on: gpio
    harness: led0
    integration_platforms:
      - frdm_k64f
```
